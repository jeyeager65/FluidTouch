## managed_components/espressif__esp_secure_cert_mgr/examples/esp_secure_cert_ota_example/main/Kconfig.projbuild
```kconfig
menu "ESP Secure Cert OTA Example Configuration"

    choice EXAMPLE_ESP_SECURE_CERT_OTA_MODE
        prompt "ESP Secure Cert OTA Mode"
        help
            Select the OTA mode for esp_secure_cert partition updates.

        config EXAMPLE_ESP_SECURE_CERT_OTA_USE_UNALLOCATED_SPACE
            bool "Use Unallocated Space"
            help
                Find unallocated space in flash and use it as staging area.
                After successful download, copy to original partition.
                Uses NVS to track staging offset during download.

        config EXAMPLE_ESP_SECURE_CERT_USE_PASSIVE_OTA
            bool "Use Passive OTA Partition"
            help
                Use the passive OTA app partition as staging area.
                Validates that partition has no valid image before using.
                After successful download, copy to original partition.

        config EXAMPLE_ESP_SECURE_CERT_DIRECT_OTA
            bool "Direct OTA"
            help
                Perform OTA directly on the original esp_secure_cert partition.
                WARNING: This mode is risky as interruption will corrupt the partition.
                No staging area or rollback capability.

    endchoice

    config EXAMPLE_FIRMWARE_UPGRADE_URL
        string "firmware upgrade url endpoint"
        default "https://192.168.0.3:8070/esp_secure_cert.bin"
        help
            URL of server which hosts the esp_secure_cert binary file

    config EXAMPLE_CERT_OTA_URL_FROM_STDIN
        bool
        default y if EXAMPLE_FIRMWARE_UPGRADE_URL = "FROM_STDIN"

    config EXAMPLE_OTA_RECV_TIMEOUT
        int "OTA receive timeout (ms)"
        default 10000
        help
            Maximum time for receiving OTA data (in milliseconds).

    config EXAMPLE_ESP_SECURE_CERT_OTA_TEST
        bool "Enable ESP Secure Cert OTA test mode"
        default n
        help
            Enable test mode for ESP Secure Cert OTA example.
            This will flash the esp_secure_cert.bin to the partition during build.
endmenu
```

## managed_components/espressif__esp_secure_cert_mgr/examples/esp_secure_cert_ota_example/sdkconfig.defaults
```kconfig
# Enable secure cert manager
CONFIG_ESP_SECURE_CERT_SUPPORT_LEGACY_FORMATS=n

# Enable OTA data partition
CONFIG_PARTITION_TABLE_CUSTOM=y
CONFIG_PARTITION_TABLE_CUSTOM_FILENAME="partitions.csv"

# Default OTA mode - Use Unallocated Space
CONFIG_EXAMPLE_ESP_SECURE_CERT_OTA_USE_UNALLOCATED_SPACE=y

# OTA timeout
CONFIG_EXAMPLE_OTA_RECV_TIMEOUT=5000
```

## managed_components/espressif__rmaker_common/components/rmaker_cmd_resp/Kconfig
```kconfig
menu "ESP RainMaker Command-Response"

    config ESP_RMAKER_MAX_COMMANDS
        int "Maximum commands supported for command-response"
        default 10
        help
            Maximum number of commands supported by the command-response framework

endmenu
```

## managed_components/espressif__rmaker_common/components/rmaker_console/Kconfig
```kconfig
menu "ESP RainMaker Console"

    config ESP_RMAKER_CONSOLE_ENABLED
        bool "Enable RMAKER common console"
        default y
        help
            Enable RainMaker common console.
            If the application has its own console, this can be disabled.

    config ESP_RMAKER_CONSOLE_TASK_STACK
        int "Console task stack"
        default 4096
        help
            Stack size for the console task.

    config ESP_RMAKER_CONSOLE_TASK_PRIORITY
        int "Console task priority"
        default 5
        help
            Priority for the console task.

endmenu
```

## managed_components/espressif__rmaker_time_sync/Kconfig
```kconfig
menu "ESP RainMaker Time Sync"

    config ESP_RMAKER_DEF_TIMEZONE
        string "Default Timezone"
        default "Asia/Shanghai"
        help
            Default Timezone to use. Eg. "Asia/Shanghai", "America/Los_Angeles".
            Check documentation for complete list of valid values. This value
            will be used only if no timezone is set using the C APIs.

    config ESP_RMAKER_SNTP_SERVER_NAME
        string "ESP RainMaker SNTP Server Name"
        default "pool.ntp.org"
        help
            Default SNTP Server which is used for time synchronization.

endmenu
```

## managed_components/espressif__rmaker_work_queue/Kconfig
```kconfig
menu "ESP RainMaker Work Queue"

    config ESP_RMAKER_WORK_QUEUE_TASK_STACK
        int "ESP RainMaker Work Queue Task stack"
        default 5120
        help
            Stack size for the ESP RainMaker Work Queue Task.

    config ESP_RMAKER_WORK_QUEUE_TASK_PRIORITY
        int "ESP RainMaker Work Queue Task priority"
        default 5
        help
            Priority for the ESP RainMaker Work Queue Task. Not recommended to be changed
            unless you really need it.

endmenu
```
